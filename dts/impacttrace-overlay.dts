/dts-v1/;
/plugin/;

/ {
	compatible = "brcm,bcm2835";

	fragment@0 {
		target = <&i2c_arm>;
		__overlay__ {
			#address-cells = <1>;
			#size-cells = <0>;

			rtc@68 {
				compatible = "impacttrace,it-ds3231";
				reg = <0x68>;
			};
		};
	};
};
